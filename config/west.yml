## config/west.yml
```yaml
manifest:
  remotes:
    - name: germain-gadel
      url-base: https://github.com/bullwinkle3000
    - name: zmkfirmware
      url-base: https://github.com/zmkfirmware
  projects:
    - name: zmk
      remote: zmkfirmware
      revision: main
      import: app/west.yml
  self:
    path: config
```
