//&pinctrl {
//    xiao_spi_default: xiao_spi_default {
//        group1 {
//            psels = <NRF_PSEL(SPIM_SCK, 1, 0)>,
//                <NRF_PSEL(SPIM_MOSI, 0, 16)>,
//                <NRF_PSEL(SPIM_MISO, 0, 4)>;
//        };
//    };
//    xiao_spi_sleep: xiao_spi_sleep {
//        group1 {
//            psels = <NRF_PSEL(SPIM_SCK, 1, 0)>,
//                <NRF_PSEL(SPIM_MOSI, 0, 16)>,
//                <NRF_PSEL(SPIM_MISO, 0, 4)>;
//            low-power-enable;
//        };
//    };
//};
//
//&xiao_spi {
//  status = "okay";
//
//  cs-gpios = <&xiao_d 2 GPIO_ACTIVE_LOW>;
////    &xiao_d 1 GPIO_ACTIVE_LOW
////    &xiao_d 0 GPIO_ACTIVE_HIGH>;
//
//  expander: mcp23sxx@0 {
//    compatible = "microchip,mcp23sxx";
//    status = "okay";
//    gpio-controller;
//    spi-max-frequency = <800000>;
//    reg = <0>;
//    label = "MCP23S17";
//    #gpio-cells = <2>;
//    ngpios = <16>;
//    int-gpios = <&xiao_d 5 GPIO_ACTIVE_LOW>;
//
//    led_disable {
//      gpio-hog;
//      gpios = <6 GPIO_ACTIVE_HIGH>;
//      output-high;
//    };
//  };

//  nice_view: ls0xx@2 {
//    compatible = "sharp,ls0xx";
//    label = "NICE_VIEW";
//    spi-max-frequency = <1000000>;
//    reg = <2>;
//    width = <160>;
//    height = <68>;
//  };
//};

/// {
//    chosen {
//        zephyr,display = &nice_view;
//    };
//};

&xiao_i2c {
    status = "disabled";
};

